## drivers/net/phy/airoha/Kconfig
```kconfig
# SPDX-License-Identifier: GPL-2.0-only
menuconfig PHY_AIROHA
	bool "Airoha Ethernet PHYs support"

config PHY_AIROHA_AN8801
	bool "Airoha Ethernet AN8801 support"
	depends on PHY_AIROHA
	select PHY_AIROHA_PHYLIB
	help
	  Currently support AIROHA AN8801 1G PHY.

config PHY_AIROHA_EN8811
	bool "Airoha Ethernet EN8811H support"
	depends on PHY_AIROHA
	depends on SUPPORTS_FW_LOADER
	select FW_LOADER
	select PHY_AIROHA_PHYLIB
	select PHY_COMMON_PROPS
	help
	  AIROHA EN8811H supported.
	  AIROHA AN8811HB supported.

config PHY_AIROHA_EN8811_BUILTIN_FW
	bool "Embed EN8811H firmware"
	depends on PHY_AIROHA_EN8811
	select LZMA
	help
	  Embed an LZMA-compressed EN8811H MD32 firmware image in U-Boot.
	  The environment-script firmware loader remains available as a fallback.

config PHY_AIROHA_PHYLIB
	bool
	help
	  Airoha Ethernet PHY common library
```
